## src/examples/led_control_example/Kconfig
```kconfig
menuconfig EXAMPLES_LED_CONTROL_EXAMPLE
	bool "led_control_example"
	default n
	---help---
		Enable support for led_control_example
```

## src/modules/led_state_module/Kconfig
```kconfig
menuconfig MODULES_LED_STATE_MODULE
	bool "led_state_module"
	default n
	---help---
		Enable support for led_state_module
```
